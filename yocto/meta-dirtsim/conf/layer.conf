## yocto/meta-dirtsim/conf/layer.conf
```bitbake
# Layer configuration for meta-dirtsim.
# Custom layer for the Sparkle Duck dirt simulation project.

# We have a conf and classes directory, add to BBPATH.
BBPATH .= ":${LAYERDIR}"

# We have recipes-* directories, add to BBFILES.
BBFILES += "${LAYERDIR}/recipes-*/*/*.bb \
            ${LAYERDIR}/recipes-*/*/*.bbappend"

BBFILE_COLLECTIONS += "dirtsim"
BBFILE_PATTERN_dirtsim = "^${LAYERDIR}/"
BBFILE_PRIORITY_dirtsim = "10"

LAYERDEPENDS_dirtsim = "core raspberrypi"
LAYERSERIES_COMPAT_dirtsim = "scarthgap styhead"
```

## yocto/meta-dirtsim/conf/machine/raspberrypi-dirtsim.conf
```bitbake
#@TYPE: Machine
#@NAME: Dirtsim Unified Raspberry Pi (Pi4 + Pi5)
#@DESCRIPTION: Unified machine configuration for Sparkle Duck supporting both
#              Raspberry Pi 4 (with Miuzei HDMI display) and
#              Raspberry Pi 5 (with HyperPixel 4.0 DPI display).

# Inherit raspberrypi4 overrides so the kernel BSP metadata is found.
# This tells recipes that need machine-specific configs to use Pi4 settings.
MACHINEOVERRIDES =. "raspberrypi4:"

# Use Cortex-A72 tuning. This runs correctly on both Pi4 (A72) and Pi5 (A76).
# A76 is backwards compatible with A72 code.
require conf/machine/include/arm/armv8a/tune-cortexa72.inc
include conf/machine/include/rpi-base.inc

# PCI support (both Pi4 and Pi5 have it).
MACHINE_FEATURES += "pci"

# WiFi and Bluetooth firmware for both Pi4 and Pi5.
MACHINE_EXTRA_RRECOMMENDS += "\
    linux-firmware-rpidistro-bcm43455 \
    bluez-firmware-rpidistro-bcm4345c0-hcd \
    linux-firmware-rpidistro-bcm43456 \
    bluez-firmware-rpidistro-bcm4345c5-hcd \
"

# Device trees for both Pi4 and Pi5 variants.
RPI_KERNEL_DEVICETREE = " \
    broadcom/bcm2711-rpi-4-b.dtb \
    broadcom/bcm2711-rpi-400.dtb \
    broadcom/bcm2711-rpi-cm4.dtb \
    broadcom/bcm2711-rpi-cm4s.dtb \
    broadcom/bcm2712-rpi-5-b.dtb \
    broadcom/bcm2712-rpi-cm5-cm5io.dtb \
    broadcom/bcm2712-rpi-cm5-cm4io.dtb \
    broadcom/bcm2712-rpi-cm5l-cm5io.dtb \
    broadcom/bcm2712-rpi-cm5l-cm4io.dtb \
"

# Include overlays for both display types.
RPI_KERNEL_DEVICETREE_OVERLAYS:append = " \
    overlays/vc4-kms-v3d-pi4.dtbo \
    overlays/vc4-kms-v3d-pi5.dtbo \
    overlays/vc4-kms-dpi-hyperpixel4.dtbo \
    overlays/ads7846.dtbo \
"

# Use proper KMS driver (not fake-KMS).
VC4DTBO ?= "vc4-kms-v3d"

# Serial console differs between Pi4 and Pi5, but we primarily use SSH.
# Pi4 uses ttyS0, Pi5 uses ttyAMA10. Include both.
SERIAL_CONSOLES ?= "115200;ttyS0 115200;ttyAMA10"

# Kernel image naming. The bootloader auto-selects based on hardware:
# - Pi4 loads kernel8.img
# - Pi5 loads kernel_2712.img
# We use kernel8.img as the primary (for Pi4), and add kernel_2712.img separately.
SDIMG_KERNELIMAGE ?= "kernel8.img"

# 64-bit kernel settings.
KERNEL_IMAGETYPE_UBOOT ?= "Image"
KERNEL_IMAGETYPE_DIRECT ?= "Image"
KERNEL_BOOTCMD ?= "booti"

UBOOT_MACHINE = "rpi_arm64_config"

# Add Pi5 kernel image to boot partition.
# The bootloader will automatically use kernel_2712.img on Pi5 hardware.
IMAGE_BOOT_FILES:append = " ${KERNEL_IMAGETYPE};kernel_2712.img"
```

## yocto/meta-dirtsim/wic/sdimage-ab.wks
```
# A/B partition layout for safe remote updates
# Each rootfs gets its own partition - system updates the inactive one
# Data partition persists across updates (WiFi credentials, logs, config)

part /boot --source bootimg-partition --ondisk sda --fstype=vfat --label boot --active --align 4096 --size 150
part / --source rootfs --ondisk sda --fstype=ext4 --label rootfs_a --align 4096 --size 800
part /rescue --source rootfs --ondisk sda --fstype=ext4 --label rootfs_b --align 4096 --size 800
part /data --ondisk sda --fstype=ext4 --label data --align 4096 --size 100
```
